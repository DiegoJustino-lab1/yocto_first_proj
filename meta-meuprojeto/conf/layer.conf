## meta-meuprojeto/conf/layer.conf
```bitbake
# We have a conf and classes directory, add to BBPATH
BBPATH .= ":${LAYERDIR}"

# We have recipes-* directories, add to BBFILES
BBFILES += "${LAYERDIR}/recipes-*/*/*.bb \
            ${LAYERDIR}/recipes-*/*/*.bbappend"

BBFILE_COLLECTIONS += "meta-meuprojeto"
BBFILE_PATTERN_meta-meuprojeto = "^${LAYERDIR}/"
BBFILE_PRIORITY_meta-meuprojeto = "6"

LAYERDEPENDS_meta-meuprojeto = "core"
LAYERSERIES_COMPAT_meta-meuprojeto = "kirkstone"
```
